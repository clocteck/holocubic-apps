## mjpeg_player/src/sdkconfig.defaults
```kconfig
CONFIG_IDF_TARGET="esp32s3"
CONFIG_ESPTOOLPY_FLASHSIZE_16MB=y
CONFIG_COMPILER_OPTIMIZATION_PERF=y
CONFIG_ELF_DYNAMIC_LOAD_SHARED_OBJECT=y
CONFIG_SPIRAM=y
CONFIG_SPIRAM_USE_MALLOC=y
CONFIG_ESP_SYSTEM_PANIC_PRINT_REBOOT=y
CONFIG_JD_USE_ROM=y
```
